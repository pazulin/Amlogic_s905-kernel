## sound/soc/aml/m8/Kconfig
```kconfig
menuconfig SND_AML_M8
	tristate "AML-SND-M8 Board"
	depends on SND_AML_M8_SOC
	select SWITCH
	select SND_SOC_PCM2BT
	select SND_SOC_DUMMY_CODEC
	select SND_SOC_AMLPMU4 if AML_PMU4
	select SND_SOC_TAS5707
	select SND_SOC_TAS5717
	select SND_SOC_TAS5731
	select SND_SOC_AMLT9015
	select SND_SOC_AMLT9015S

if SND_AML_M8

config SND_AML_SPLIT_MODE
	tristate "AIU split mode, otherwise normal mode"
	depends on SND_AML_M8_SOC
	help
		Say 'Y' to enable AIU split mode. If not, it's normal mode.

config SND_AML_SPLIT_MODE_MMAP
	tristate "AIU split mode, mmap"
	depends on SND_AML_SPLIT_MODE
	depends on SND_AML_M8_SOC
	help
		Say 'Y' or 'N' to enable/disable AIU split mmap

endif

menuconfig SND_AML_M8_NEW
	tristate "AML-SND-M8-NEW card"
	depends on SND_AML_M8_SOC

menuconfig SND_AML_M8_NEW1
	tristate "AML-SND-M8-NEW1 Board"
	depends on SND_AML_M8_SOC
#	select SWITCH
#	select SND_SOC_PCM2BT
#	select SND_SOC_TAS5717
#	select SND_SOC_TAS5731
#	select SND_SOC_AMLT9015
#	select SND_SOC_AMLT9015S

#if SND_AML_M8_NEW1

#config SND_AML_SPLIT_MODE
#	tristate "AIU split mode, otherwise normal mode"
#	depends on SND_AML_M8_SOC
#	help
#		Say 'Y' to enable AIU split mode. If not, it's normal mode.

#config SND_AML_SPLIT_MODE_MMAP
#	tristate "AIU split mode, mmap"
#	depends on SND_AML_SPLIT_MODE
#	depends on SND_AML_M8_SOC
#	help
#		Say 'Y' or 'N' to enable/disable AIU split mmap

#endif

menuconfig SND_AML_G9TV
	tristate "AML-SND-G9TV Board"
	depends on SND_AML_M8_SOC && SWITCH
	select SND_SOC_DUMMY_CODEC
	select SND_SOC_AMLPMU4 if AML1220
	select SND_SOC_TAS5707
```
